AUTOSAR XML (schema 00050)
package /ARRoot
  can cluster PowerWindowLeftCanCluster: protocol-name=Can Cluster Conditional
    can physical channel PowerWindowLeftCanPhysicalChannel: comm-connectors=PowerWindowLeftCanCommunicationConnector
  ecu instance PowerWindowLeftECUInstance
    can communication controller PowerWindowLeftCanCommunicationController
    can communication connector PowerWindowLeftCanCommunicationConnector: comm-controller=PowerWindowLeftCanCommunicationController
  flat map PowerWindowLeftFlatMap: instances=flat-instance-descriptor=PowerWindowLeftSystem.PowerWindowLeftRootSoftwareComposition.PowerWindowLeft
  system PowerWindowLeftSystem
    system mapping PowerWindowLeftSoftwareMapping: client-server-to-signal-mapping=communication-direction=OUT
      sw-impl-mappings:
        swc to impl mapping PowerWindowLeftSwcToImpleMapping: component-implementation=PowerWindowImpFile, component=PowerWindowLeftRootSoftwareComposition.PowerWindowLeftSwComponentProto.PowerWindowLeftSwComponentProto
      sw-mappings:
        swc to ecu mapping PowerWindowLeftSwcToEcuMapping: component=PowerWindowLeftRootSoftwareComposition.PowerWindowLeftSwComponentProto.PowerWindowLeftSwComponentProto, controlled-hw-element=/ARRoot/, ecu-instance=PowerWindowLeftECUInstance, processing-unit=/ARRoot/
    root-software-compositions:
      root sw composition prototype PowerWindowLeftRootSoftwareComposition: flat-map=PowerWindowLeftFlatMap, software-composition=PowerWindowLeftTopLevelComposition
  composition sw component type PowerWindowLeftTopLevelComposition
    component PowerWindowLeftSwComponentProto: type=PowerWindowControllerType
    delegation sw connector PowerWindowLeftConnectorProto: outer-port=PowerWindowLeft
  can cluster PowerWindowRightCanCluster: protocol-name=Can Cluster Conditional
    can physical channel PowerWindowRightCanPhysicalChannel: comm-connectors=PowerWindowRightCanCommunicationConnector
  ecu instance PowerWindowRightECUInstance
    can communication controller PowerWindowRightCanCommunicationController
    can communication connector PowerWindowRightCanCommunicationConnector: comm-controller=PowerWindowRightCanCommunicationController
  flat map PowerWindowRightFlatMap: instances=flat-instance-descriptor=PowerWindowRightSystem.PowerWindowRightRootSoftwareComposition.PowerWindowRight
  system PowerWindowRightSystem
    system mapping PowerWindowRightSoftwareMapping: client-server-to-signal-mapping=communication-direction=OUT
      sw-impl-mappings:
        swc to impl mapping PowerWindowRightSwcToImpleMapping: component-implementation=PowerWindowImpFile, component=PowerWindowRightRootSoftwareComposition.PowerWindowRightSwComponentProto.PowerWindowRightSwComponentProto
      sw-mappings:
        swc to ecu mapping PowerWindowRightSwcToEcuMapping: component=PowerWindowRightRootSoftwareComposition.PowerWindowRightSwComponentProto.PowerWindowRightSwComponentProto, controlled-hw-element=/ARRoot/, ecu-instance=PowerWindowRightECUInstance, processing-unit=/ARRoot/
    root-software-compositions:
      root sw composition prototype PowerWindowRightRootSoftwareComposition: flat-map=PowerWindowRightFlatMap, software-composition=PowerWindowRightTopLevelComposition
  composition sw component type PowerWindowRightTopLevelComposition
    component PowerWindowRightSwComponentProto: type=PowerWindowControllerType
    delegation sw connector PowerWindowRightConnectorProto: outer-port=PowerWindowRight
